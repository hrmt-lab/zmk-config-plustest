## boards/shields/plustest/Kconfig.defconfig
```kconfig
if SHIELD_PLUSTEST
config ZMK_KEYBOARD_NAME
    default "plustest"

config NFCT_PINS_AS_GPIOS
    default y
    
endif
```

## config/west.yml
```yaml
manifest:
  defaults:
    revision: v0.3
  remotes:
    - name: zmkfirmware
      url-base: https://github.com/zmkfirmware
    - name: sekigon-gonnoc
      url-base: https://github.com/sekigon-gonnoc
    # Additional modules containing boards/shields/custom code can be listed here as well
    # See https://docs.zephyrproject.org/3.2.0/develop/west/manifest.html#projects
  projects:
    - name: zmk
      remote: zmkfirmware
      revision: v0.3.0
      import: app/west.yml
    - name: zmk-feature-non-lipo-battery-management
      remote: sekigon-gonnoc
  self:
    path: config
```
